## config/west.yml
```yaml
manifest:
  remotes:
    - name: zmkfirmware
      url-base: https://github.com/zmkfirmware
    - name: makalan604  
      url-base: https://github.com/makalan604   
  projects:
    - name: zmk
      remote: makalan604  
      revision: main
      import: app/west.yml
  self:
    path: config
```
